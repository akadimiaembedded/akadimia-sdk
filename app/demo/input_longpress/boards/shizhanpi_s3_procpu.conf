## app/demo/input_longpress/boards/shizhanpi_s3_procpu.conf
```kconfig
# Copyright (c) 2025 liangyq <liangyongqincn@gmail.com>
# 
# SPDX-License-Identifier: Apache-2.0

# INPUT
CONFIG_INPUT=y

# LOG
CONFIG_LOG=y

# INPUT SUBSYSTEM LOG
CONFIG_INPUT_LOG_LEVEL_DBG=y
```

## boards/akadimia/aka_stm32f429igt6/Kconfig.aka_stm32f429igt6
```kconfig
# Copyright (c) 2025 liangyq <liangyongqincn@gmail.com>
# 
# SPDX-License-Identifier: Apache-2.0

config BOARD_AKA_STM32F429IGT6
    select SOC_STM32F429XX
```

## boards/akadimia/aka_stm32f429igt6/board.yml
```yaml
# Copyright (c) 2025 liangyq <liangyongqincn@gmail.com>
# 
# SPDX-License-Identifier: Apache-2.0

board:
  name: aka_stm32f429igt6
  vendor: akadimia
  socs:
    - name: stm32f429xx
    
```

## boards/embedfire/challenger/board.yml
```yaml
board:
  name: challenger
  vendor: embedfire
  socs:
    - name: stm32f429xx
    
```

## boards/lichuang/shizhanpi_s3/Kconfig
```kconfig
# Copyright (c) 2025 liangyq <liangyongqincn@gmail.com>
# 
# SPDX-License-Identifier: Apache-2.0

config HEAP_MEM_POOL_ADD_SIZE_BOARD
	int
	default 4096 if BOARD_SHIZHANPI_S3_ESP32S3_PROCPU
	default 256 if BOARD_SHIZHANPI_S3_ESP32S3_APPCPU
```

## boards/lichuang/shizhanpi_s3/Kconfig.shizhanpi_s3
```kconfig
# Copyright (c) 2025 liangyq <liangyongqincn@gmail.com>
# 
# SPDX-License-Identifier: Apache-2.0

config BOARD_SHIZHANPI_S3
	select SOC_ESP32S3_WROOM_N16R8
	select SOC_ESP32S3_PROCPU if BOARD_SHIZHANPI_S3_ESP32_S3_PROCPU
	select SOC_ESP32S3_APPCPU if BOARD_SHIZHANPI_S3_ESP32_S3_APPCPU
```

## boards/lichuang/shizhanpi_s3/board.yml
```yaml
# Copyright (c) 2025 liangyq <liangyongqincn@gmail.com>
# 
# SPDX-License-Identifier: Apache-2.0

board:
  name: shizhanpi_s3
  full_name: shizhanpi-s3
  vendor: lichuang
  socs:
  - name: esp32s3
```

## boards/lichuang/shizhanpi_s3/shizhanpi_s3_appcpu_defconfig
```kconfig
# Copyright (c) 2025 liangyq <liangyongqincn@gmail.com>
# 
# SPDX-License-Identifier: Apache-2.0

CONFIG_CLOCK_CONTROL=y
```

## west.yml
```yaml
manifest:
  defaults:
      remote: akadimia-embedded

  remotes:
    - name: akadimia-embedded
      url-base: https://github.com/akadimiaembedded

  projects:
    - name: akadimia-zephyr
      revision: v4.1.0
      path: zephyr
      import: true
    - name: hal_geehy
      revision: main
      path: modules/hal/geehy
      groups:
        - hal
    - name: hal_xhsc
      revision: main
      path: modules/hal/xhsc
      groups:
        - hal
    - name: hal_sifli
      revision: main
      path: modules/hal/sifli
      groups:
        - hal
      
  self:
    path: .
```
